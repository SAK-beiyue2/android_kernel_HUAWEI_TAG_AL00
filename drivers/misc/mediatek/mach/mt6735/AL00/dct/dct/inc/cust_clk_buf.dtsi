/*
 * Generated by MTK SP Drv_CodeGen Version 03.13.6  for MT6753. Copyright MediaTek Inc. (C) 2013.
 * Wed Jun 20 13:09:07 2018
 * Do Not Modify the File.
 */

&rf_clock_buffer_ctrl {
	compatible = "mediatek, rf_clock_buffer";
	buffer1 = <2>;
	buffer2 = <1>;
	buffer3 = <1>;
	buffer4 = <1>;
};
